## drivers/motor_actuator/Kconfig.esp32s3
```kconfig
# Copyright (c) 2026 Freedom Veiculos Eletricos
# SPDX-License-Identifier: UNLICENSED

# ESP32-S3: MCPWM HAL (motor-stage-hbridge-esp32s3).

config MOTOR_STAGE_HBRIDGE_ESP32S3
	bool "ESP32-S3 MCPWM H-bridge (zephyr,motor-stage-hbridge-esp32s3)"
	depends on SOC_SERIES_ESP32S3
	depends on GPIO
	select PINCTRL
	help
	  H-bridge via MCPWM HAL (no Zephyr PWM driver on the hot path).

config MOTOR_STAGE_HBRIDGE_ESP32S3_INIT_PRIORITY
	int "Init priority for motor-stage-hbridge-esp32s3"
	default 45
	depends on MOTOR_STAGE_HBRIDGE_ESP32S3
	help
	  Must run before the sensor driver so MCPWM is configured first.
```

## drivers/motor_actuator/Kconfig.stm32
```kconfig
# Copyright (c) 2026 Freedom Veiculos Eletricos
# SPDX-License-Identifier: UNLICENSED

# STM32: LL timers (motor-stage-hbridge-stm32).

config MOTOR_STAGE_HBRIDGE_STM32
	bool "STM32 LL H-bridge (zephyr,motor-stage-hbridge-stm32)"
	depends on SOC_SERIES_STM32G4X
	depends on GPIO
	select PINCTRL
	help
	  H-bridge using STM32 LL timers (no Zephyr PWM on the hot path).

config MOTOR_STAGE_HBRIDGE_STM32_INIT_PRIORITY
	int "Init priority for motor-stage-hbridge-stm32"
	default 45
	depends on MOTOR_STAGE_HBRIDGE_STM32
	help
	  Must run before motor-sensor-encoder-stm32 so the timer is configured first.
```

## drivers/motor_sensor/Kconfig
```kconfig
# Copyright (c) 2026 Freedom Veiculos Eletricos
# SPDX-License-Identifier: UNLICENSED

# SoC-specific motor sensors (STM32 LL, ESP32-S3, …).

menu "Motor sensors"

rsource "Kconfig.stm32"
rsource "Kconfig.esp32s3"

endmenu
```

## drivers/motor_sensor/Kconfig.esp32s3
```kconfig
# Copyright (c) 2026 Freedom Veiculos Eletricos
# SPDX-License-Identifier: UNLICENSED

# ESP32-S3: SAR ADC digital + GDMA; MCPWM TEZ/TEP sync (motor-sensor-encoder-esp32s3).

config MOTOR_SENSOR_ENCODER_ESP32S3
	bool "ESP32-S3 encoder + ADC Digi EOF (zephyr,motor-sensor-encoder-esp32s3)"
	depends on SOC_SERIES_ESP32S3
	depends on GPIO
	select DMA
	depends on ADC
	help
	  Current sense via SAR ADC digital mode + GDMA; EOF invokes sync-actuator callback;
	  MCPWM sync uses TEZ/TEP ISR (no ETM on ESP32-S3).

config MOTOR_SENSOR_ENCODER_ESP32S3_INIT_PRIORITY
	int "Init priority for motor-sensor-encoder-esp32s3"
	default 46
	depends on MOTOR_SENSOR_ENCODER_ESP32S3

config MOTOR_ESP32S3_MCPWM_SYNC_IRQ_PRIORITY
	int "esp_intr_alloc priority for MCPWM TEZ/TEP ISR (ESP32-S3 sensor)"
	default 2
	range 1 15
	depends on MOTOR_SENSOR_ENCODER_ESP32S3
	help
	  Used only when zephyr,mcpwm-sync-irq-priority is not set in devicetree.
```

## dts/bindings/motor-control/zephyr,motor-algorithm-dc-current.yaml
```yaml
# Copyright (c) 2026 Zephyr Motor Control Contributors
# SPDX-License-Identifier: Apache-2.0

description: |
  DC brushed / single-axis current loop: scalar PI, duty to the H-bridge driver.
  Referenced from zephyr,motor-controller via the ``algorithm`` phandle.

compatible: "zephyr,motor-algorithm-dc-current"

include: base.yaml

properties:
  dc-current-kp-milli:
    type: int
    default: 500
    description: Current-loop Kp × 1000 (500 = 0.5).

  dc-current-ki-milli:
    type: int
    default: 2000000
    description: Current-loop Ki × 1000 (2000000 = 2000).

  dc-current-out-min-milli:
    type: int
    default: -1000
    description: Normalised duty lower limit × 1000 (-1000 = -1.0).

  dc-current-out-max-milli:
    type: int
    default: 1000
    description: Normalised duty upper limit × 1000 (1000 = 1.0).

  current-loop-rate-hz:
    type: int
    default: 20000
    description: |
      Inner-loop (ISR) rate in Hz. Must be ≤ PWM frequency on the actuator.

  i-max-ma:
    type: int
    required: true
    description: Software current limit in mA (enforced in the loop / limits struct).
```

## dts/bindings/motor-control/zephyr,motor-sensor-encoder-common.yaml
```yaml
# Copyright (c) 2026 Zephyr Motor Control Contributors
# SPDX-License-Identifier: Apache-2.0

# Shared motion/calibration fields for encoder + current backends.
# SoC-specific bindings include this fragment and add ADC/PWM/timer wiring.

include: base.yaml

properties:
  encoder-timer:
    type: phandle
    required: false
    description: |
      Timer peripheral configured as a counter (quadrature encoder mode).
      Optional for bring-up with current feedback only; position/speed stay invalid.

  encoder-cpr:
    type: int
    required: true
    description: |
      Encoder counts per revolution after quadrature decoding.
      For a 1024 CPR encoder with 4x decoding: encoder-cpr = <4096>.

  pole-pairs:
    type: int
    required: true
    description: |
      Motor pole pairs. Used to convert mechanical angle to electrical
      angle: theta_elec = theta_mech * pole-pairs.
      For a DC brushed motor with no Park transform: pole-pairs = <1>.

  index-gpios:
    type: phandle-array
    description: |
      Optional encoder index (Z) pulse GPIO for absolute-zero alignment.
      When present, the backend performs an index search at enable() and
      sets valid_theta = true only after the index pulse is detected.

  current-offset-ua:
    type: array
    description: |
      Per-channel current sense offset in microamperes at zero current.
      Applied during calibration; overrides runtime offset measurement when present.
      Length is defined by the leaf binding (e.g. matches `io-channels` on the
      generic Zephyr ADC path).
```

## dts/bindings/motor-control/zephyr,motor-sensor-encoder-esp32s3.yaml
```yaml
# Copyright (c) 2026 Zephyr Motor Control Contributors
# SPDX-License-Identifier: Apache-2.0

description: |
  ESP32-S3: phase current via SAR ADC digital mode + DMA; end-of-block (EOF) latches
  the sample and invokes the sync-actuator callback. MCPWM→conversion sync uses TEZ/TEP
  ISR (ESP32-S3 has no ETM in HAL).

compatible: "zephyr,motor-sensor-encoder-esp32s3"

include: "zephyr,motor-sensor-encoder-common.yaml"

properties:
  st,adc:
    type: phandle
    required: true
    description: ADC node (e.g. &adc0); may be status disabled for the Zephyr ADC driver.

  adc-channel:
    type: int
    required: true
    description: SAR channel index (0..9, SoC-dependent).

  adc-attenuation-db:
    type: int
    default: 11
    description: Approximate attenuation in dB (0, 2, 6, 11) for the channel.

  digi-block-samples:
    type: int
    default: 1
    description: Samples per EOF block (minimum 1).

  adc-digi-sample-freq-hz:
    type: int
    default: 20000
    description: SAR digital controller sample frequency (Hz).

  zephyr,mcpwm-sync-irq-priority:
    type: int
    description: Priority for MCPWM TEZ/TEP ISR (esp_intr_alloc). Falls back to Kconfig if unset.

  sync-actuator:
    type: phandle
    required: true

  mcpwm-sync:
    type: phandle
    required: true
    description: MCPWM instance used by the power stage (for TEZ/TEP ISR).

  mcpwm-sync-index:
    type: int
    default: 0
    description: 0 = MCPWM0, 1 = MCPWM1 (must match the stage).

  sync-timer-id:
    type: int
    default: 0
    description: MCPWM timer index for TEZ/TEP sync ISR (ISR only; Digi ADC runs continuously).

  sync-edge:
    type: string
    default: "tez"
    enum:
      - tez
      - tep
    description: Timer empty (tez) or timer full (tep).

  zephyr,adc-dma-priority:
    type: int
    description: Optional GDMA/ADC ISR priority (reserved for future use).
```

## dts/bindings/motor-control/zephyr,motor-sensor-encoder-stm32.yaml
```yaml
# Copyright (c) 2026 Zephyr Motor Control Contributors
# SPDX-License-Identifier: Apache-2.0

description: |
  STM32 encoder + current sense without adc_read() in the ISR: the ADC is
  programmed for injected (or regular) conversions triggered by the PWM timer
  TRGO; the ADC EOC ISR latches results and invokes the power-stage control
  callback (see sync-actuator).

compatible: "zephyr,motor-sensor-encoder-stm32"

include: "zephyr,motor-sensor-encoder-common.yaml"

properties:
  st,adc:
    type: phandle
    required: true
    description: ADC controller (e.g. &adc1).

  adc-injected:
    type: boolean
    description: |
      If true, use injected group (typical for sync with timer). Default true
      if property is absent (boolean default in driver).

  adc-channel:
    type: int
    required: true
    description: |
      SOC ADC channel index for phase-A current (STM32 LL_ADC_CHANNEL_x index
      as used by Cube — match N in ADCx_INN from the datasheet).

  adc-trigger-timer:
    type: phandle
    required: true
    description: Timer providing TRGO to the ADC external trigger (same as PWM timer).

  adc-ext-trigger-inj:
    type: int
    description: |
      STM32 LL_ADC_INJ_TRIG_EXT_TIMx_TRGO constant for this SoC (injected).
      If omitted, the driver selects a default for the timer instance (G4).

  sync-actuator:
    type: phandle
    required: true
    description: |
      Power-stage device whose registered motor_control_cb_t is invoked from
      the ADC ISR after latching the current sample (timer→ADC→ISR chain).

  zephyr,adc-irq-priority:
    type: int
    required: false
    description: |
      NVIC priority for the ADC interrupt. If omitted, Kconfig
      MOTOR_STM32_ADC_IRQ_PRIORITY is used.

  io-channels:
    type: phandle-array
    description: |
      Optional extra channels (e.g. v_bus) for future use; primary current uses
      adc-channel on st,adc.

  io-channel-names:
    type: string-array
    description: Names for optional io-channels.
```

## dts/bindings/motor-control/zephyr,motor-sensor-encoder.yaml
```yaml
# Copyright (c) 2026 Zephyr Motor Control Contributors
# SPDX-License-Identifier: Apache-2.0

description: |
  Quadrature encoder position/speed backend combined with phase current
  sensing (3-shunt, 2-shunt, or 1-shunt DC-link) for motor control.

  The encoder provides absolute angle after index-pulse alignment (or
  relative angle before alignment). Phase currents are sampled by ADC
  channels hardware-triggered from the PWM timer underflow event.

compatible: "zephyr,motor-sensor-encoder"

include: base.yaml

properties:
  encoder-timer:
    type: phandle
    required: true
    description: Timer peripheral configured in quadrature encoder input mode.

  encoder-cpr:
    type: int
    required: true
    description: |
      Encoder counts per revolution after quadrature decoding.
      For a 1024 CPR encoder with 4x decoding: encoder-cpr = <4096>.

  pole-pairs:
    type: int
    required: true
    description: |
      Motor pole pairs. Used to convert mechanical angle to electrical
      angle: theta_elec = theta_mech * pole-pairs.
      For a DC brushed motor with no Park transform: pole-pairs = <1>.

  index-gpio:
    type: phandle-array
    description: |
      Optional encoder index (Z) pulse GPIO for absolute-zero alignment.
      When present, the backend performs an index search at enable() and
      sets valid_theta = true only after the index pulse is detected.

  io-channels:
    type: phandle-array
    required: true
    description: |
      ADC channels for phase current measurement.
      Provide 1, 2, or 3 channels:
        1 channel: DC-link single shunt (i_phase_a); Ib and Ic reconstructed.
        2 channels: dual shunt (i_phase_a, i_phase_b); Ic = -Ia - Ib.
        3 channels: 3-shunt (i_phase_a, i_phase_b, i_phase_c); no reconstruction.
      An optional additional channel named "v_bus" may be appended.

  io-channel-names:
    type: string-array
    description: |
      Names for io-channels entries.
      Valid names: "i_phase_a", "i_phase_b", "i_phase_c", "v_bus".

  adc-trigger-event:
    type: int
    description: |
      Hardware trigger event ID linking the PWM center-aligned underflow
      event to the ADC start-of-conversion. Platform-specific.
      STM32 example: TIM1_TRGO = 0x00000001.
      If absent, ADC uses software trigger (lower timing accuracy).

  current-offset-ua:
    type: array
    description: |
      Per-channel current sense offset in microamperes at zero current.
      Applied during calibration; overrides runtime offset measurement
      when present. Array length must match io-channels count.
```

## dts/bindings/motor-control/zephyr,motor-sensor-hall.yaml
```yaml
# Copyright (c) 2026 Zephyr Motor Control Contributors
# SPDX-License-Identifier: Apache-2.0

description: |
  Hall effect sensor × 3 position backend for BLDC trapezoidal or
  sinusoidal (FOC) control. Provides 60° resolution sector-based
  position and period-based speed estimation.

  Hall sensors are detected via GPIO EXTI on both edges. Sector
  transitions update the electrical angle in 60° steps; the angle
  between transitions is linearly interpolated.

  No alignment sequence is required — Hall sensors provide an
  absolute sector at standstill. The controller transitions directly
  from IDLE to RUN on enable().

compatible: "zephyr,motor-sensor-hall"

include: base.yaml

properties:
  hall-gpios:
    type: phandle-array
    required: true
    description: |
      Three Hall sensor GPIO inputs [H_U, H_V, H_W].
      All three must support GPIO_INT_EDGE_BOTH.
      Example:
        hall-gpios = <&gpioc 6 GPIO_ACTIVE_HIGH>,
                     <&gpioc 7 GPIO_ACTIVE_HIGH>,
                     <&gpioc 8 GPIO_ACTIVE_HIGH>;

  pole-pairs:
    type: int
    required: true
    description: Motor pole pairs.

  hall-sequence:
    type: array
    description: |
      Custom Hall sector → commutation step mapping (6 entries, values 1–6).
      Default: standard 120° Hall sequence [5, 1, 3, 2, 6, 4].
      Override when the motor wiring produces a non-standard sequence.

  io-channels:
    type: phandle-array
    description: |
      ADC channels for phase current measurement. Same conventions as
      zephyr,motor-sensor-encoder-stm32 (io-channels / channel naming).

  io-channel-names:
    type: string-array
    description: |
      Names for io-channels entries.
      Valid names: "i_phase_a", "i_phase_b", "i_phase_c", "v_bus".

  adc-trigger-event:
    type: int
    description: |
      Hardware ADC trigger event ID. Platform-specific.
      If absent, software-triggered ADC is used.
```

## dts/bindings/motor-control/zephyr,motor-sensor-resolver.yaml
```yaml
# Copyright (c) 2026 Zephyr Motor Control Contributors
# SPDX-License-Identifier: Apache-2.0

description: |
  Resolver position backend using SIN and COS ADC channels.
  Electrical angle is computed via atan2(SIN, COS) with a
  software or hardware tracking observer.

  Resolvers are robust to temperature and vibration, making them
  common in automotive and industrial servo applications.
  No alignment sequence is required.

compatible: "zephyr,motor-sensor-resolver"

include: base.yaml

properties:
  io-channels:
    type: phandle-array
    required: true
    description: |
      ADC channels in order:
        [resolver_sin, resolver_cos, i_phase_a, i_phase_b, i_phase_c]
      The current-sense channels follow the same conventions as
      zephyr,motor-sensor-encoder-stm32. The resolver SIN/COS channels must
      be sampled synchronously with the current channels.

  io-channel-names:
    type: string-array
    description: |
      Names for io-channels entries.
      Valid names: "resolver_sin", "resolver_cos",
                   "i_phase_a", "i_phase_b", "i_phase_c", "v_bus".

  pole-pairs:
    type: int
    required: true
    description: Motor pole pairs.

  excitation-frequency-hz:
    type: int
    description: |
      Resolver excitation signal frequency (Hz).
      Default: 10000 (10 kHz).
    default: 10000

  resolver-offset-mrad:
    type: int
    description: |
      Electrical angle offset from mechanical zero (milliradians).
      Applied after atan2 to align the resolver zero with the motor
      d-axis. Determined during commutation alignment at installation.
    default: 0

  adc-trigger-event:
    type: int
    description: Hardware ADC trigger event ID. Platform-specific.
```

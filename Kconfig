## dts/bindings/motor-control/zephyr,motor-sensor-sensorless.yaml
```yaml
# Copyright (c) 2026 Zephyr Motor Control Contributors
# SPDX-License-Identifier: Apache-2.0

description: |
  Sensorless position/speed backend using BEMF or flux observer.
  Requires phase current and bus voltage sensing. Not valid at
  standstill unless observer-type includes HFI.

  Supported observer types:
    bemf-pu  : Per-unit BEMF observer. Valid above ~5% rated speed.
               Requires open-loop start-up ramp to acquire tracking.
    flux-hfi : Flux observer with HFI injection for standstill and
               low-speed operation. Requires Ld != Lq (salient motor).
    mras     : Model Reference Adaptive System. Used for AC induction
               motor slip estimation.

compatible: "zephyr,motor-sensor-sensorless"

include: base.yaml

properties:
  io-channels:
    type: phandle-array
    required: true
    description: |
      ADC channels in order: [i_phase_a, i_phase_b, v_bus].
      A third current channel (i_phase_c) may optionally be added
      for 3-shunt sensing; otherwise Ic = -Ia - Ib.

  io-channel-names:
    type: string-array
    description: |
      Names for io-channels entries.
      Valid names: "i_phase_a", "i_phase_b", "i_phase_c", "v_bus".

  pole-pairs:
    type: int
    required: true
    description: Motor pole pairs.

  observer-type:
    type: string
    enum:
      - "bemf-pu"
      - "flux-hfi"
      - "mras"
    default: "bemf-pu"
    description: Observer algorithm variant. See binding description.

  rs-mohm:
    type: int
    required: true
    description: |
      Stator resistance in milliohms (mΩ).
      Used by the observer voltage model.

  ld-uh:
    type: int
    required: true
    description: |
      D-axis inductance in microhenries (µH).

  lq-uh:
    type: int
    required: true
    description: |
      Q-axis inductance in microhenries (µH).
      For isotropic motors (SPM): lq-uh = ld-uh.
      For salient motors (IPM): lq-uh > ld-uh (required for flux-hfi).

  flux-linkage-uwb:
    type: int
    description: |
      Permanent magnet flux linkage in micro-Weber (µWb).
      Required for PMSM bemf-pu and flux-hfi observers.
      Not used for MRAS (AC induction).

  adc-trigger-event:
    type: int
    description: |
      Hardware ADC trigger event ID. Platform-specific.
      Center-aligned PWM underflow trigger is strongly recommended
      for sensorless — sampling jitter degrades observer accuracy.
```

## dts/bindings/motor-control/zephyr,motor-stage-3ph-inverter.yaml
```yaml
# Copyright (c) 2026 Zephyr Motor Control Contributors
# SPDX-License-Identifier: Apache-2.0

description: |
  3-phase 6-switch inverter power stage for BLDC, PMSM, and AC
  induction motor control.

  The backend implements:
    - Atomic PWM shadow register update (all three phases committed
      simultaneously at the next PWM reload event)
    - Hardware dead-time insertion (no software dead-time required)
    - Center-aligned (up-down) PWM for noise-free ADC sampling at
      the underflow event
    - Hardware fault path: nFAULT GPIO assertion immediately inhibits
      all PWM outputs without CPU involvement
    - Optional STO dual-channel hardware PWM inhibit (ASIL-B)

  set_vector(Vα, Vβ) maps to SVPWM internally.
  set_duty([d0, d1, d2]) is available for 6-step and V/f control.

  This node is also compatible with RFC #102158 Solution 2 (Unified
  Inverter Driver) semantics when adc-trigger-event and sto-gpios
  are defined.

compatible: "zephyr,motor-stage-3ph-inverter"

include: base.yaml

properties:
  pwm-u:
    type: phandle
    required: true
    description: |
      Timer instance for phase U complementary PWM output.
      The timer must be configured for center-aligned (up-down) mode
      with complementary outputs (CHx + CHxN) and hardware dead-time.

  pwm-v:
    type: phandle
    required: true
    description: Timer instance for phase V complementary PWM output.

  pwm-w:
    type: phandle
    required: true
    description: Timer instance for phase W complementary PWM output.

  pwm-frequency:
    type: int
    required: true
    description: |
      PWM switching frequency in Hz. Center-aligned mode is strongly
      recommended (and assumed by default). The actual timer period
      is computed as: ARR = (timer_clock / pwm-frequency) / 2.

  deadtime-rising-ns:
    type: int
    required: true
    description: |
      Rising edge dead-time in nanoseconds. Inserted between the
      turn-off of the low-side transistor and the turn-on of the
      high-side transistor. The backend converts to timer DTG register
      ticks at init time.

  deadtime-falling-ns:
    type: int
    required: true
    description: |
      Falling edge dead-time in nanoseconds. Inserted between the
      turn-off of the high-side transistor and the turn-on of the
      low-side transistor.

  nfault-gpios:
    type: phandle-array
    description: |
      Gate driver nFAULT GPIO (active-low, interrupt-capable).
      The hardware has already disabled outputs when this asserts.
      The backend fires motor_fault_cb_t with MOTOR_FAULT_GATE_DRIVER.

  en-gpios:
    type: phandle-array
    description: Gate driver enable GPIO (active-high or active-low).

  sto-gpios:
    type: phandle-array
    description: |
      Dual-channel Safe Torque Off input GPIOs [STO_CH1, STO_CH2].
      Both channels must be GPIO_ACTIVE_HIGH and interrupt-capable.
      When both assert, the power stage immediately inhibits all PWM
      outputs in hardware. The controller transitions to
      MOTOR_STATE_STO and motor_fault_cb_t fires.
      Required for ASIL-B and above. Absence causes motor_sto_arm()
      to return -ENOTSUP.
      Example:
        sto-gpios = <&gpioe 10 GPIO_ACTIVE_HIGH>,
                    <&gpioe 11 GPIO_ACTIVE_HIGH>;

  elc:
    type: phandle
    description: |
      Event Link Controller phandle (Renesas platform).
      Links the PWM timer underflow event directly to the ADC trigger
      without CPU intervention. Platform-specific — omit on STM32
      (use adc-trigger-event in the sensor node instead).

  poeg:
    type: phandle
    description: |
      Port Output Enable for GPT phandle (Renesas POEG).
      Hardware PWM shutoff path for the Renesas platform.
      Platform-specific.

  io-channels:
    type: phandle-array
    description: |
      ADC channels for bus voltage and board temperature monitoring.
      These are read by the supervision thread (cold region), not the
      current-loop ISR. Channel names: "v_bus", "temp_board".

  io-channel-names:
    type: string-array
    description: |
      Names for io-channels entries.
      Valid names: "v_bus", "temp_board".

  vbus-nominal-mv:
    type: int
    required: true
    description: Nominal DC-link voltage in millivolts.

  vbus-ov-thresh-mv:
    type: int
    required: true
    description: |
      Overvoltage fault threshold in millivolts.
      Supervision thread triggers MOTOR_FAULT_OVERVOLTAGE when Vbus
      exceeds this level.

  vbus-uv-thresh-mv:
    type: int
    required: true
    description: |
      Undervoltage fault threshold in millivolts.
      Supervision thread triggers MOTOR_FAULT_UNDERVOLTAGE when Vbus
      falls below this level.

  i-peak-limit-ma:
    type: int
    required: true
    description: |
      Peak phase current hardware limit in milliamperes.
      The comparator-based hardware overcurrent protection is
      configured to this threshold at init. Below this level the
      current loop software limit (i-max-ma in the controller node)
      applies first.
```

## dts/bindings/motor-control/zephyr,motor-stage-hbridge-esp32s3.yaml
```yaml
# Copyright (c) 2026 Zephyr Motor Control Contributors
# SPDX-License-Identifier: Apache-2.0

description: |
  ESP32-S3 H-bridge using MCPWM (direct HAL, not LEDC). ADC synchronization is handled
  in the sensor driver (TEZ/TEP ISR + ADC Digi), not in this node.

compatible: "zephyr,motor-stage-hbridge-esp32s3"

include: ["zephyr,motor-stage-hbridge-common.yaml", pinctrl-device.yaml]

properties:
  mcpwm:
    type: phandle
    required: true
    description: MCPWM instance (e.g. &mcpwm0).

  mcpwm-index:
    type: int
    required: true
    description: MCPWM group index (0 = MCPWM0, 1 = MCPWM1).

  timer-id:
    type: int
    required: true
    description: MCPWM timer (0..2). Use 0 for PWM0A/PWM0B H-bridge.

  prescale:
    type: int
    default: 1
    description: Global MCPWM prescaler (8-bit; see espressif,esp32-mcpwm).

  prescale-timer0:
    type: int
    default: 0
    description: Timer prescaler for timer-id.
```

## dts/bindings/motor-control/zephyr,motor-stage-hbridge.yaml
```yaml
# Copyright (c) 2026 Zephyr Motor Control Contributors
# SPDX-License-Identifier: Apache-2.0

description: |
  Single full-bridge (H-bridge) power stage for DC brushed motors,
  or dual H-bridge for 2-phase stepper motors.

  The left half-bridge drives forward direction; the right half-bridge
  drives reverse. The actuator backend maps the signed Vα from
  set_vector() to PWM duty:
    Vα > 0  →  left half-bridge active  (forward)
    Vα < 0  →  right half-bridge active (reverse)
    Vα = 0  →  both disabled            (coast or brake per drive mode)

  set_duty([d]) is also supported for open-loop duty control.

compatible: "zephyr,motor-stage-hbridge"

include: base.yaml

properties:
  pwm-left:
    type: phandle-array
    required: true
    description: PWM specifier for the left (forward) half-bridge output.

  pwm-right:
    type: phandle-array
    required: true
    description: PWM specifier for the right (reverse) half-bridge output.

  nfault-gpios:
    type: phandle-array
    description: |
      Gate driver nFAULT input GPIO (active-low, interrupt-capable).
      When asserted, the hardware has already disabled outputs.
      The backend fires motor_fault_cb_t with MOTOR_FAULT_GATE_DRIVER.

  nsleep-gpios:
    type: phandle-array
    description: |
      Gate driver nSLEEP / shutdown GPIO (active-high or active-low
      depending on driver). Used to place the driver in low-power mode
      when the motor is idle.

  sto-gpios:
    type: phandle-array
    description: |
      Dual-channel Safe Torque Off input GPIOs [STO_CH1, STO_CH2].
      Both channels must be GPIO_ACTIVE_HIGH and interrupt-capable.
      When both assert, PWM outputs are inhibited in hardware.
      Required for ASIL-B and above. If absent, motor_sto_arm()
      returns -ENOTSUP.
      Example:
        sto-gpios = <&gpiob 10 GPIO_ACTIVE_HIGH>,
                    <&gpiob 11 GPIO_ACTIVE_HIGH>;

  pwm-frequency:
    type: int
    required: true
    description: PWM switching frequency in Hz.

  deadtime-ns:
    type: int
    default: 0
    description: |
      Dead-time between complementary half-bridge transitions
      (nanoseconds). Set to 0 if the gate driver IC handles
      dead-time internally (e.g. DRV8833).

  vbus-fault-threshold-mv:
    type: int
    description: |
      Bus voltage fault threshold in millivolts used during the
      self_test() transistor check sequence. If the bus voltage
      collapses below this level while both low-side transistors
      are off, a multiple-short condition is flagged.

  io-channels:
    type: phandle-array
    description: |
      Optional ADC channels for bus voltage and board temperature.
      Channel names: "v_bus", "temp_board".

  io-channel-names:
    type: string-array
    description: |
      Names for optional io-channels entries.
      Valid names: "v_bus", "temp_board".
```

## samples/dc_current/sample.yaml
```yaml
# Copyright (c) 2026 Zephyr Motor Control Contributors
# SPDX-License-Identifier: Apache-2.0
#
# Build-only check: west twister -T samples/dc_current (from repo root)
# with ZEPHYR_EXTRA_MODULES set to this repository.

sample:
  description: DC brushed current loop (scalar PI) with STM32 LL sensor/stage
  name: dc_current
common:
  tags: motor
tests:
  samples.motor.dc_current:
    build_only: true
    extra_args: CONF_FILE=prj_stm32_ll.conf
    integration_platforms:
      - nucleo_g474re
```

## samples/dc_current_full_bridge/sample.yaml
```yaml
# Copyright (c) 2026 Zephyr Motor Control Contributors
# SPDX-License-Identifier: Apache-2.0
#
# Build-only check: west twister -T samples/dc_current_full_bridge (from repo root)
# with ZEPHYR_EXTRA_MODULES set to this repository.

sample:
  description: DC brushed current loop on full-bridge STM32 LL stage
  name: dc_current_full_bridge
common:
  tags: motor
tests:
  samples.motor.dc_current_full_bridge:
    build_only: true
    extra_args: CONF_FILE=prj_stm32_ll.conf
    integration_platforms:
      - nucleo_g474re
```

## tests/motor/algo_dc_torque/testcase.yaml
```yaml
# Copyright (c) 2026 Freedom Veiculos Eletricos
# SPDX-License-Identifier: Apache-2.0
#
# native_sim: use ../../run_twister.sh or export NSI_OPT=-O2 before twister (NSI host -O0 + glibc).

common:
  tags:
    - motor
    - motor_algo
tests:
  motor.algo.dc_torque:
    integration_platforms:
      - native_sim/native/64
```

## tests/motor/motor_api_extensibility/testcase.yaml
```yaml
# Copyright (c) 2026 Freedom Veiculos Eletricos
# SPDX-License-Identifier: Apache-2.0
#
# native_sim: use ../../run_twister.sh or export NSI_OPT=-O2 before twister.

common:
  tags:
    - motor
    - motor_api
tests:
  motor.api.extensibility:
    integration_platforms:
      - native_sim/native/64
```

## tests/motor/motor_subsys/testcase.yaml
```yaml
# Copyright (c) 2026 Zephyr Motor Control Contributors
# SPDX-License-Identifier: Apache-2.0

common:
  tags:
    - motor
    - motor_subsys
tests:
  motor.subsys:
    integration_platforms:
      - native_sim/native/64
```

## west.yml
```yaml
# Copyright (c) 2024-2026 Freedom Veiculos Eletricos
# SPDX-License-Identifier: UNLICENSED

manifest:
  defaults:
    remote: freedom

  remotes:
    - name: zephyrproject-rtos
      url-base: https://github.com/zephyrproject-rtos
    - name: freedom
      url-base: git@github.com:FreedomVeiculosEletricos

  projects:
    - name: zephyr
      remote: zephyrproject-rtos
      revision: v4.4.0-rc3
      import:
        path-prefix: deps
        name-allowlist:
          - cmsis_6
          - hal_atmel
          - hal_espressif
          - hal_nordic
          - hal_stm32
          - mcuboot
          - mbedtls
          - tf-psa-crypto
          - zcbor
  self:
    import:
```

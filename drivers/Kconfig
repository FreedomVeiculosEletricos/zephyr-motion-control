## drivers/Kconfig
```kconfig
# Copyright (c) 2026 Freedom Veiculos Eletricos
# SPDX-License-Identifier: UNLICENSED

menu "Motor control drivers"

rsource "motor_sensor/Kconfig"
rsource "motor_actuator/Kconfig"
rsource "motor_encoder_observer/Kconfig"

module = MOTOR_DRIVER
module-str = motor driver
source "subsys/logging/Kconfig.template.log_config"

endmenu
```

## drivers/motor_actuator/Kconfig.espressif_mcpwm
```kconfig
# Copyright (c) 2026 Freedom Veiculos Eletricos
# SPDX-License-Identifier: UNLICENSED

config MOTOR_STAGE_HBRIDGE_ESPRESSIF_MCPWM
	bool "Espressif MCPWM H-bridge (zephyr,motor-stage-hbridge-espressif-mcpwm)"
	depends on SOC_FAMILY_ESPRESSIF_ESP32
	depends on COUNTER
	depends on GPIO
	select PINCTRL
	help
	  Full-bridge using MCPWM low-level HAL. Requires an espressif,esp32-mcpwm node
	  referenced by the motor stage (mcpwm phandle).

config MOTOR_STAGE_HBRIDGE_ESPRESSIF_MCPWM_INIT_PRIORITY
	int "Init priority for zephyr,motor-stage-hbridge-espressif-mcpwm"
	default 45
	depends on MOTOR_STAGE_HBRIDGE_ESPRESSIF_MCPWM
	help
	  Run before encoder or other drivers that sync to MCPWM timing.
```

## drivers/motor_encoder_observer/Kconfig
```kconfig
# Copyright (c) 2026 Freedom Veiculos Eletricos
# SPDX-License-Identifier: UNLICENSED

config MOTOR_ENCODER_OBSERVER
	bool "Virtual rotation sensor fed by the sensorless velocity observer"
	default y
	depends on DT_HAS_ZEPHYR_MOTOR_ENCODER_OBSERVER_ENABLED
	depends on SENSOR
	help
	  Exposes the observer estimate through the Zephyr Sensor API so it can
	  replace a magnetic encoder as the feedback-sensor of a motor sensor.
```

## drivers/motor_sensor/Kconfig.esp32
```kconfig
# Copyright (c) 2026 Freedom Veiculos Eletricos
# SPDX-License-Identifier: UNLICENSED

# Espressif: SAR ADC digital + GDMA or I2S/SPI-linked DMA (legacy SoCs).

config MOTOR_SENSOR_ESP32
	bool "Espressif motor sensor (zephyr,motor-sensor-esp32)"
	depends on SOC_FAMILY_ESPRESSIF_ESP32
	depends on GPIO
	select DMA if DT_HAS_ESPRESSIF_ESP32_GDMA_ENABLED
	depends on ADC
	help
	  Current sense via SAR ADC digital mode. GDMA SoCs use the ADC DMA channel
	  from devicetree; ESP32/ESP32-S2 use I2S/SPI EOF like Zephyr adc_esp32_dma.
	  Requires SOC_ADC_DIG_CTRL_SUPPORTED (enforced in driver).

config MOTOR_SENSOR_ESP32_INIT_PRIORITY
	int "Init priority for zephyr,motor-sensor-esp32"
	default 46
	depends on MOTOR_SENSOR_ESP32

config MOTOR_ESP32_MCPWM_SYNC_IRQ_PRIORITY
	int "esp_intr_alloc priority for MCPWM TEZ/TEP ISR (motor_sensor_esp32)"
	default 2
	range 1 15
	depends on MOTOR_SENSOR_ESP32
	help
	  Used only when zephyr,mcpwm-sync-irq-priority is not set in devicetree.
```

## drivers/motor_sensor/Kconfig.stm32
```kconfig
# Copyright (c) 2026 Freedom Veiculos Eletricos
# SPDX-License-Identifier: UNLICENSED

# STM32: LL ADC injected sequence, software trigger (zephyr,motor-sensor-stm32).

config MOTOR_SENSOR_STM32
	bool "STM32 motor sensor (zephyr,motor-sensor-stm32)"
	depends on SOC_FAMILY_STM32
	depends on CLOCK_CONTROL
	select ZERO_LATENCY_IRQS
	help
	  Current sense via LL ADC injected group; JEOC ISR latches samples.
	  The driver owns the ADC: it gates the peripheral clock itself and
	  does not need the Zephyr ADC driver.

config MOTOR_SENSOR_STM32_INIT_PRIORITY
	int "Init priority for zephyr,motor-sensor-stm32"
	default 95
	depends on MOTOR_SENSOR_STM32
	help
	  Must run after the power stage and after any feedback sensor named by
	  the feedback-sensor property, which init at SENSOR_INIT_PRIORITY.

config MOTOR_STM32_ADC_IRQ_PRIORITY
	int "Default NVIC priority for ADC JEOC ISR (STM32 sensor)"
	default 2
	range 0 15
	depends on MOTOR_SENSOR_STM32
	help
	  Used when zephyr,adc-irq-priority is not set in devicetree.
```

## dts/bindings/motor-control/zephyr,motor-algorithm-adrc-current.yaml
```yaml
# Copyright (c) 2026 Zephyr Motor Control Contributors
# SPDX-License-Identifier: Apache-2.0

description: |
  Linear ADRC current loop for brushed DC / single-axis current control with
  a 2-state LESO (z1, z2). Referenced from zephyr,motor-controller via the
  ``algorithm`` phandle.

compatible: "zephyr,motor-algorithm-adrc-current"

include: base.yaml

properties:
  adrc-current-kp-milli:
    type: int
    default: 1000
    description: Proportional gain Kp × 1000.

  adrc-current-b0-milli:
    type: int
    default: 1000
    description: Plant gain estimate b0 × 1000. Must be > 0.

  adrc-current-beta1-milli:
    type: int
    default: 2000
    description: LESO beta1 × 1000.

  adrc-current-beta2-milli:
    type: int
    default: 100000
    description: LESO beta2 × 1000.

  adrc-current-out-min-milli:
    type: int
    default: -1000
    description: Normalised control lower limit × 1000 (-1000 = -1.0).

  adrc-current-out-max-milli:
    type: int
    default: 1000
    description: Normalised control upper limit × 1000 (1000 = 1.0).

  i-max-ma:
    type: int
    required: true
    description: Software current limit in mA.

  sign-magnitude:
    type: boolean
    description: |
      When set, map control output to one HS leg at a time (duty on leg 0 for
      u >= 0, leg 1 for u < 0). Used with single-ended gate drivers on a
      full-bridge. When unset, bipolar complementary duty (d, 1-d) is used.
```

## dts/bindings/motor-control/zephyr,motor-algorithm-velocity-observer.yaml
```yaml
# Copyright (c) 2026 Zephyr Motor Control Contributors
# SPDX-License-Identifier: Apache-2.0

description: |
  Sensorless velocity observer for brushed DC motors. Runs on the inner (PWM
  ISR) stage, recovers the back-EMF from the measured current as a disturbance
  state, and turns it into a smooth speed with a scalar tracking loop.

  It produces no actuator command and no current reference: the estimate is
  published to the virtual encoder pointed to by ``sensor-sink``, which the
  motor sensor then consumes as its ``feedback-sensor``.

  Place it before the current controller in the ``algorithm`` phandles list of
  zephyr,motor-controller. The estimator always consumes the command applied on
  the previous tick, so the order only affects when the estimate is refreshed.

compatible: "zephyr,motor-algorithm-velocity-observer"

include: base.yaml

properties:
  motor-resistance-mohm:
    type: int
    required: true
    description: Armature resistance in milliohms.

  motor-inductance-uh:
    type: int
    required: true
    description: Armature inductance in microhenries.

  motor-ke-uv-per-rad-s:
    type: int
    required: true
    description: |
      Back-EMF constant in microvolts per rad/s. Numerically equal to the torque
      constant in uN.m/A for a brushed DC motor.

  vbus-nominal-mv:
    type: int
    default: 12000
    description: |
      Bus voltage backing the normalized command, in millivolts. Matches the
      nominal value assumed by the H-bridge backends; an error here scales the
      estimate proportionally.

  observer-bandwidth-rad-s:
    type: int
    default: 2000
    description: |
      Places both estimator poles at -w. Must sit well above the electrical pole
      R/L and well below the inner loop rate; a decade below the PWM frequency
      in rad/s is a safe starting point.

  pll-kp-milli:
    type: int
    default: 100
    description: |
      Tracking loop proportional gain × 1000. Must stay below 1000: the loop
      sees its own output one tick late, so the discrete poles sit at
      sqrt(kp) and a unit gain oscillates without settling.

  pll-ki-milli:
    type: int
    default: 200000
    description: |
      Tracking loop integral gain × 1000. The dominant pole sits near
      ki / (1 + kp), so these defaults give roughly 180 rad/s. Also bounded by
      ki × dt < 2 × (1 - kp) for the same discrete-time reason.

  valid-threshold-mrad-s:
    type: int
    default: 20000
    description: |
      Speed in mrad/s above which the estimate becomes valid. Below it the
      back-EMF is buried in the current offset and in the temperature drift of
      the resistance.

  valid-release-mrad-s:
    type: int
    default: 15000
    description: |
      Speed in mrad/s below which the estimate becomes invalid again. Must not
      exceed valid-threshold-mrad-s; the gap is the hysteresis band.

  settle-ticks:
    type: int
    default: 2000
    description: |
      Inner ticks held invalid after a reset, covering the convergence
      transient. At 20 kHz, 2000 ticks is 100 ms.

  sensor-sink:
    type: phandle
    description: |
      zephyr,motor-encoder-observer node fed with the estimate. Omit it to run
      the observer as pure telemetry.
```

## dts/bindings/motor-control/zephyr,motor-algorithm-velocity-pi.yaml
```yaml
# Copyright (c) 2026 Zephyr Motor Control Contributors
# SPDX-License-Identifier: Apache-2.0

description: |
  Outer velocity PI with a tracking PLL on measured rotor angle. Outputs a
  current reference for the next (inner) pipeline block. Referenced from
  zephyr,motor-controller via the ordered ``algorithm`` phandles list.

compatible: "zephyr,motor-algorithm-velocity-pi"

include: base.yaml

properties:
  velocity-pi-kp-milli:
    type: int
    default: 1000
    description: Velocity PI proportional gain Kp × 1000.

  velocity-pi-ki-milli:
    type: int
    default: 100
    description: Velocity PI integral gain Ki × 1000.

  velocity-pll-kp-milli:
    type: int
    default: 20000
    description: Angle-tracking PLL proportional gain × 1000.

  velocity-pll-ki-milli:
    type: int
    default: 100000
    description: Angle-tracking PLL integral gain × 1000.

  i-max-ma:
    type: int
    required: true
    description: Software current reference limit in mA.

  open-loop-startup-current-ma:
    type: int
    default: 0
    description: |
      Current in mA pushed in the commanded direction while the angle feedback
      is invalid. Zero holds the last reference instead, which suits a real
      encoder but stalls a sensorless start, since the observer only becomes
      valid once the rotor is already turning. Must not exceed i-max-ma.
```

## dts/bindings/motor-control/zephyr,motor-controller.yaml
```yaml
# Copyright (c) 2026 Zephyr Motor Control Contributors
# SPDX-License-Identifier: Apache-2.0

description: |
  Motor controller: composes one sensor, one actuator, and an ordered algorithm
  pipeline (phandles). The user wires concrete devices and algorithm nodes in
  Devicetree; the subsystem exposes a @c motor_t handle to the application API.

  @c algorithm is an ordered list outer → inner. A single phandle remains valid
  (current-only). Example cascade::

    algorithm = <&vel_pi &adrc>;

compatible: "zephyr,motor-controller"

include: base.yaml

properties:
  sensor:
    type: phandle
    required: true
    description: |
      Sensor backend (e.g. zephyr,motor-sensor-stm32). See
      per-sensor bindings (e.g. pole-pairs on position sensors).

  actuator:
    type: phandle
    required: true
    description: |
      Power stage (e.g. zephyr,motor-stage-hbridge-stm32): N half-bridges, see
      zephyr,motor-stage-hbridge-common.yaml.

  algorithm:
    type: phandles
    required: true
    description: |
      Ordered algorithm pipeline (outer → inner). Each phandle references a
      node such as zephyr,motor-algorithm-velocity-pi,
      zephyr,motor-algorithm-dc-current, or zephyr,motor-algorithm-adrc-current.
```

## dts/bindings/motor-control/zephyr,motor-encoder-observer.yaml
```yaml
# Copyright (c) 2026 Zephyr Motor Control Contributors
# SPDX-License-Identifier: Apache-2.0

description: |
  Virtual rotation sensor fed by zephyr,motor-algorithm-velocity-observer.

  It has no bus and no hardware behind it: the observer block publishes into it
  from the control ISR and it exposes the result through the Zephyr Sensor API,
  so it can be used as the ``feedback-sensor`` of a motor sensor in place of a
  magnetic encoder.

  It is a passive sink and references nothing, which is what keeps the
  devicetree free of a phandle cycle with the motor sensor.

compatible: "zephyr,motor-encoder-observer"

include: sensor-device.yaml
```

## dts/bindings/motor-control/zephyr,motor-sensor-base.yaml
```yaml
# Copyright (c) 2026 Zephyr Motor Control Contributors
# SPDX-License-Identifier: Apache-2.0

include: base.yaml

properties:
  adc:
    type: phandle
    required: true
    description: |
      SoC ADC block used by the in-tree driver (HAL/LL), not the Zephyr adc API.

  adc-channels:
    type: array
    required: true
    description: |
      Per-SoC channel indices (e.g. STM32 LL decimal channel id per rank order).
      Number of entries is the number of composite current channels.

  sync-actuator:
    type: phandle
    required: true
    description: Power-stage device paired with this sensor (timing / coordination).

  current-sense-legs:
    type: array
    required: false
    description: |
      Which half-bridge leg each entry of adc-channels measures, given as an
      index into the paired actuator's pwm-channels. One cell per adc-channels
      entry, same order.

      Per-leg sensing sits on the low side of the bridge, either a shunt or the
      Rds(on) of the low-side FET. It only reports a magnitude, and only reads
      the load current while that low side conducts, which holds for the whole
      PWM period only on the leg held at zero duty. Which leg that is flips with
      the direction of travel, so without this map the driver cannot tell a
      reading of the conducting leg from a reading of the idle one, and one
      direction of travel measures the wrong leg. Given the map, the
      driver resolves MOTOR_SENSOR_CHAN_CURRENT_BRIDGE on every conversion.

      Sign convention for a two-leg bridge: leg 0 clamped means the current is
      negative, leg 1 clamped means positive, matching the duty ordering that
      sign-magnitude algorithms emit.

      Omit on boards that do not sense per leg; MOTOR_SENSOR_CHAN_CURRENT_BRIDGE
      is then unsupported and consumers fall back to the composite vector.

  feedback-sensor:
    type: phandle
    required: false
    description: |
      Optional Zephyr sensor device for angle (e.g. SENSOR_CHAN_ROTATION).
      Requires CONFIG_SENSOR. Updated from thread context via
      motor_sensor_start_sample(MOTOR_SENSOR_CHAN_ANGLE); get_sample
      for angle still return the last latched value (ISR-safe read).

  amps-per-volt-milli:
    type: int
    default: 1000
    description: Current scale A/V = value / 1000 (default 1.0 A/V).

  adc-vref-mv:
    type: int
    default: 3300
    description: |
      ADC full-scale reference voltage in millivolts. Combined with
      adc-resolution-bits and amps-per-volt-milli, the driver precomputes a
      single amps-per-count scaling factor used in the hot path — so this
      value must match the actual analog front-end (regulator Vref on
      STM32, or the full-scale voltage implied by adc-channel-attenuation-db
      on ESP32, e.g. ~1100 mV at 0 dB, ~1500 mV at 2.5 dB, ~2200 mV at
      6 dB, ~3300 mV at 12 dB).

  adc-resolution-bits:
    type: int
    default: 12
    description: |
      ADC resolution in bits (counts = 1 << bits). Drivers that allow
      runtime configuration of the ADC peripheral honor this value; on
      SoCs where the resolution is fixed the value is informational and
      the driver still uses it to derive the counts factor — pick the
      value that matches the SoC's native resolution.
```

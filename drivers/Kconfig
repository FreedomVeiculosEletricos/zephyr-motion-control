## dts/bindings/motor-control/zephyr,motor-sensor-esp32.yaml
```yaml
# Copyright (c) 2026 Zephyr Motor Control Contributors
# SPDX-License-Identifier: Apache-2.0

description: |
  Espressif ESP32 family: SAR ADC digital + EOF latch (GDMA on S3/C3/H2…, or
  I2S/SPI-linked DMA on ESP32 / ESP32-S2). adc-channels must have exactly one
  entry. Requires SOC_ADC_DIG_CTRL_SUPPORTED; GDMA SoCs need adc ``dmas`` in DTS.

compatible: "zephyr,motor-sensor-esp32"

include: "zephyr,motor-sensor-base.yaml"

properties:
  adc-channel-attenuation-db:
    type: int
    default: 11
    description: SAR attenuation (0, 2, 6, 11 dB).

  digi-block-samples:
    type: int
    default: 1

  adc-digi-sample-freq-hz:
    type: int
    default: 20000

  zephyr,mcpwm-sync-irq-priority:
    type: int
    description: MCPWM TEZ/TEP ISR priority if used.

  mcpwm-sync:
    type: phandle
    required: true
    description: MCPWM instance (register base).

  sync-timer-id:
    type: int
    default: 0

  sync-edge:
    type: string
    default: "tez"
    enum:
      - tez
      - tep
```

## dts/bindings/motor-control/zephyr,motor-sensor-stm32.yaml
```yaml
# Copyright (c) 2026 Zephyr Motor Control Contributors
# SPDX-License-Identifier: Apache-2.0

description: |
  STM32: injected ADC sequence latched by the JEOC ISR, with an optional Zephyr
  sensor for angle via feedback-sensor.

  The conversion is started either from software in the PWM update ISR or by the
  TRGO of the paired actuator's timer; see adc-trigger.

compatible: "zephyr,motor-sensor-stm32"

include: "zephyr,motor-sensor-base.yaml"

properties:
  zephyr,adc-irq-priority:
    type: int
    required: false
    description: NVIC priority for ADC interrupt (default Kconfig).

  adc-trigger:
    type: string
    required: false
    default: "software"
    enum:
      - software
      - actuator-trgo
    description: |
      What starts an injected conversion.

      "software" starts it from the PWM update ISR (JEXTEN stays cleared). The
      sampling instant then carries the interrupt latency and whatever the
      control pipeline did before the start, so it lands at an arbitrary point
      of the switching cycle and the reading picks up the switching ripple
      instead of averaging through it.

      "actuator-trgo" points JEXTSEL at the TRGO of the timer behind
      sync-actuator, so the hardware starts the conversion at the same point of
      every period with no CPU involvement. Where in the period that is comes
      from the actuator's trgo-source: "update" samples at the period boundary,
      "compare_pulse" samples at the programmable offset set by
      adc-sample-offset-ns. The timer must have a TRGO that this ADC can select
      as an injected trigger; init fails with -ENOTSUP otherwise.
```

## dts/bindings/motor-control/zephyr,motor-stage-hbridge-espressif-mcpwm.yaml
```yaml
# Copyright (c) 2026 Zephyr Motor Control Contributors
# SPDX-License-Identifier: Apache-2.0

description: |
  Full-bridge DC stage on Espressif MCPWM using the SoC mcpwm_ll HAL (not Zephyr PWM).
  Applies to any target whose Espressif HAL exposes hal/mcpwm_ll.h for the MCPWM block.

compatible: "zephyr,motor-stage-hbridge-espressif-mcpwm"

include: ["zephyr,motor-stage-hbridge-common.yaml", pinctrl-device.yaml]

properties:
  mcpwm:
    type: phandle
    required: true
    description: MCPWM controller (espressif,esp32-mcpwm), e.g. &mcpwm0.

  mcpwm-index:
    type: int
    required: true
    description: MCPWM group index (0 = first peripheral instance, 1 = second, etc.).

  timer-id:
    type: int
    required: true
    description: Timer index inside the group (typically 0 for first complementary pair).

  prescale:
    type: int
    default: 1
    description: MCPWM group clock prescaler (see espressif,esp32-mcpwm).

  prescale-timer0:
    type: int
    default: 0
    description: Timer prescaler for timer-id.
```

## dts/bindings/motor-control/zephyr,motor-stage-hbridge-stm32.yaml
```yaml
# Copyright (c) 2026 Zephyr Motor Control Contributors
# SPDX-License-Identifier: Apache-2.0

description: |
  STM32 motor power stage using ST LL timer APIs directly (no Zephyr PWM on the
  hot path). Each entry in pwm-channels selects one timer channel (1..4) that
  drives one half-bridge leg as a complementary HS/LS pair (CHx + CHxN) with
  hardware dead-time. A timer with complementary outputs and a "brk" interrupt
  (TIM1 / TIM8 on STM32G4 etc.) is required for that mode and is checked at
  build time. General-purpose timers are allowed only together with
  "single-ended", where the gate driver produces the low side and the timer
  never needs a complementary output.

  By default, pinctrl state "complementary" is applied with 2 * len(pwm-channels)
  pin entries (HS + LS per leg). When the optional "single-ended" flag is set,
  state "single-ended" is applied instead with len(pwm-channels) pin entries
  (HS only); the LS pin stays at its hardware reset state. The timer still
  generates the complementary signal internally — it just is not routed to a
  pin in that mode.

  Use one timer instance for all legs so switching stays coherent across the
  bridge, and so the single TRGO this node exports lines current sampling up
  with it. Disable the Zephyr pwm child node for the same timer
  (status = "disabled") so the peripheral is not claimed twice.

compatible: "zephyr,motor-stage-hbridge-stm32"

include: ["zephyr,motor-stage-hbridge-common.yaml", pinctrl-device.yaml]

properties:
  st,pwm-timer:
    type: phandle
    required: true
    description: |
      Timer instance driving the bridge (e.g. &timers1, &timers8, or a
      general-purpose timer such as &timers2 when single-ended is set). This is
      also the timer whose TRGO a paired motor-sensor-stm32 node selects when
      its adc-trigger is "actuator-trgo", so it must have a TRGO that the ADC
      accepts as an injected trigger.

  pwm-channels:
    type: array
    required: true
    description: |
      Timer channel index per half-bridge leg (1..4), one cell per leg, e.g.
      pwm-channels = <1 2>; Length 1 = single half-bridge; length 2 =
      full-bridge DC (bidirectional); length 3 = reserved for future
      multi-leg topologies. Each channel always drives a complementary
      CHx/CHxN pair in the timer (single-ended only affects pinmux routing).

  trgo-source:
    type: string
    required: true
    enum:
      - update
      - reset
      - enable
      - compare_pulse
    description: |
      TIM TRGO output selection (maps to STM32 LL_TIM_TRGO_*). This only picks
      what the timer exports; it has no effect until something consumes it,
      which today means a motor-sensor-stm32 node with
      adc-trigger = "actuator-trgo".

      "update" fires once per period at the period boundary, which with
      edge-aligned PWM is the instant both compare registers reload. It is
      rejected with center-aligned, where the counter updates twice per period.

      "compare_pulse" fires on the CC1 compare match instead, putting the
      trigger at the programmable offset given by adc-sample-offset-ns. Use it
      to move current sampling away from the switching edge. Channel 1 must not
      be listed in pwm-channels, since the stage programs CC1 for this purpose.
      With center-aligned, it fires at the centre of every leg's high pulse.

  center-aligned:
    type: boolean
    description: |
      Count up to ARR and back down instead of up and wrapping, keeping
      pwm-frequency as the full up-and-down period. Every leg runs PWM mode 1,
      so its high pulse is centred on the valley of the count whatever the
      duty. Both switching edges sit symmetrically around that point, as far
      from it as the duty allows.

      With trgo-source = "compare_pulse", the ADC is triggered at that centre,
      in the middle of the high pulse. The actuator callback runs from the
      update at the peak of the count, half a period later, so the conversion
      has finished by then; the duty it writes is loaded at the next valley.

      Without a repetition counter the compare registers also reload at the
      peak, so a new duty takes effect half-way through the pulse it lands
      in: that pulse is asymmetric, and the next one is centred again.

  expose-adc-trigger:
    type: boolean
    description: |
      Drive the CC1 compare match out on a pin, so a scope can see exactly when
      the ADC conversion is triggered. Only meaningful with
      trgo-source = "compare_pulse".

      The output rises on the compare match that starts the conversion. With
      edge-aligned PWM, the channel is put in PWM mode 2 and falls at the period
      boundary. With center-aligned, it is put in PWM mode 1 and forms a pulse
      centred on the valley like the legs', twice adc-sample-offset-ns wide (a
      couple of timer ticks at the default of 0). The edge is produced by the
      timer itself, carrying no interrupt latency, so it marks the sampling
      instant rather than an approximation of it.

      Requires one extra pin entry in the pinctrl states, for the timer's
      channel 1, beyond the one per entry in pwm-channels. Bench instrument:
      leave it off in production, where it only wastes a pin.

  adc-sample-offset-ns:
    type: int
    required: false
    default: 0
    description: |
      Offset from the start of the PWM period to the CC1 compare match, in
      nanoseconds. Only meaningful with trgo-source = "compare_pulse".

      With center-aligned, it is instead how far before the centre of the high
      pulse the conversion starts, and must stay under half the period. Leave
      it at 0 to sample at the centre; raise it to centre the ADC sampling
      window rather than its start on the pulse.

      The point has to clear the switching transition of the modulating leg for
      the current sense to be quiet, and must stay inside the period; the driver clamps
      it to the period and warns. A value close to the end of the period places
      the conversion just before the update ISR that consumes it.
```

## subsys/Kconfig
```kconfig
# Copyright (c) 2026 Freedom Veiculos Eletricos
# SPDX-License-Identifier: Apache-2.0

menu "Motor control subsystem"

config MOTOR_CONTROL_TEST_API
	bool "Motor control subsystem for ZTEST (fake devices, no hardware drivers)"
	depends on ZTEST
	default n
	help
	  Relaxes MOTOR_CONTROL_LIB dependencies so tests can link motor_ctrl with
	  in-tree fake devices only. Do not enable in production firmware.

config MOTOR_CONTROL_LIB
	bool "Motor controller core and application API"
	default y
	depends on MOTOR_CONTROL_TEST_API || \
		   (((MOTOR_STAGE_HBRIDGE_STM32 || MOTOR_STAGE_HBRIDGE_ESPRESSIF_MCPWM) && \
		    (MOTOR_SENSOR_STM32 || MOTOR_SENSOR_ESP32)))
	help
	  Builds motor_ctrl, motor_* API, and in-tree algorithm backends
	  (dc-current, adrc-current, velocity-pi).

config MOTOR_ALGO_VELOCITY_OBSERVER
	bool "Sensorless velocity observer algorithm block"
	depends on MOTOR_CONTROL_LIB
	default y
	help
	  Back-EMF observer that estimates brushed DC rotor speed from the
	  measured current, for use with zephyr,motor-algorithm-velocity-observer
	  nodes. Costs an extra second-order update in the PWM ISR.

config MOTOR_SUBSYS
	bool "Motor multi-instance DT registration (motor_subsys_* API)"
	depends on MOTOR_CONTROL_LIB
	default y
	help
	  Iterable MOTOR_SUBSYS_DEFINE entries, motor_subsys_init(), and
	  motor_subsys_get_by_label() / get_by_index().

if MOTOR_SUBSYS

config MOTOR_SUBSYS_AUTO_INIT
	bool "Invoke motor_subsys_init() from SYS_INIT"
	default y
	help
	  Runs after kernel and device init so sensor/actuator devices are ready.

config MOTOR_SUBSYS_INIT_PRIORITY
	int "motor_subsys_init SYS_INIT priority (APPLICATION level)"
	default 99
	range 0 99999
	depends on MOTOR_SUBSYS_AUTO_INIT

config MOTOR_MAX_INSTANCES
	int "Maximum registered motor instances"
	default 8
	range 1 32

config MOTOR_CONTROL_SHELL
	bool "Motor shell (list, use, current, enable, DC pi/limits, …)"
	depends on SHELL
	depends on MOTOR_SUBSYS
	default n
	help
	  Register interactive ``motor`` commands for bench tuning. Requires
	  @kconfig{CONFIG_MOTOR_SUBSYS} and a console.

endif # MOTOR_SUBSYS

endmenu
```
